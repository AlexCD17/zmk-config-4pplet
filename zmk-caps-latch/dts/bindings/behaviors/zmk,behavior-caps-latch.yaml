## zmk-caps-latch/dts/bindings/behaviors/zmk,behavior-caps-latch.yaml
```yaml
description: Taps a keycode on both press and release (for latching switches)

compatible: "zmk,behavior-caps-latch"

include: one_param.yaml
```
